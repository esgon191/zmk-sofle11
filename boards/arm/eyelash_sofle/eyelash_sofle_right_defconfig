## boards/arm/eyelash_sofle/eyelash_sofle_right_defconfig
```kconfig
# Copyright (c) 2024 The ZMK Contributors
# SPDX-License-Identifier: MIT

CONFIG_SOC_SERIES_NRF52X=y
CONFIG_SOC_NRF52840_QIAA=y
CONFIG_BOARD_EYELASH_SOFLE_RIGHT=y

# --- Power & Clock ---
CONFIG_CLOCK_CONTROL_NRF_K32SRC_XTAL=y
CONFIG_CLOCK_CONTROL_NRF_K32SRC_30PPM=y

# --- Core peripherals ---
CONFIG_ARM_MPU=y
CONFIG_PINCTRL=y
CONFIG_GPIO=y
CONFIG_SPI=y

# --- Flash / boot / UF2 ---
CONFIG_USE_DT_CODE_PARTITION=y
CONFIG_BUILD_OUTPUT_UF2=y
CONFIG_FLASH=y
CONFIG_FLASH_MAP=y
CONFIG_FLASH_PAGE_LAYOUT=y
CONFIG_MPU_ALLOW_FLASH_WRITE=y
CONFIG_NVS=y
CONFIG_SETTINGS_NVS=y

# --- SPLIT mode ---
CONFIG_ZMK_SPLIT=y
# CONFIG_ZMK_SPLIT_ROLE_PERIPHERAL=y
CONFIG_ZMK_SPLIT_BLE=y

# --- BLE ---
CONFIG_ZMK_BLE=y
CONFIG_BT=y
CONFIG_BT_PERIPHERAL=y
CONFIG_BT_CTLR_TX_PWR_PLUS_8=y

# --- USB must be OFF on right half ---
CONFIG_ZMK_USB=n

# --- External Power ---
CONFIG_ZMK_EXT_POWER=y
```
